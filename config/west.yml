## config/west.yml
```yaml
manifest:
  remotes:
    - name: zmkfirmware
      url-base: https://github.com/zmkfirmware
    - name: dhruvinsh
      url-base: https://github.com/dhruvinsh
    - name: prospector
      url-base: https://github.com/t-ogura
  projects:
    - name: eyelash_sofle
      url: https://github.com/a741725193/zmk-sofle
      revision: main
    - name: zmk
      remote: zmkfirmware
      revision: main
      import: app/west.yml
    - name: zmk-tri-state
      remote: dhruvinsh
      revision: main
    - name: prospector-zmk-module
      remote: prospector
      revision: v1.1.1
      path: modules/prospector-zmk-module
  self:
    path: boards
```
